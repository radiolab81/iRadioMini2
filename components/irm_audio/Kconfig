## components/irm_display/Kconfig
```kconfig
menu "iRadioMini2: Anzeige"
    choice IRM_DISPLAY
        prompt "Anzeige-Backend"
        default IRM_DISPLAY_NONE
        config IRM_DISPLAY_NONE
            bool "keine"
        config IRM_DISPLAY_SSD1306
            bool "OLED SSD1306 128x64/128x32 (I2C, u8g2)"
        config IRM_DISPLAY_HD44780
            bool "Zeichen-LCD HD44780 mit PCF8574-I2C-Adapter"
        config IRM_DISPLAY_SERVO
            bool "Servo-Zeiger (Senderskala)"
        config IRM_DISPLAY_LVGL
            bool "LVGL-Farbdisplay (ILI9341/ST7789, SPI) mit Skins"
    endchoice

    config IRM_DISPLAY_I2C_ADDR
        hex "I2C-Adresse (7 Bit)"
        depends on IRM_DISPLAY_SSD1306 || IRM_DISPLAY_HD44780
        default 0x3C if IRM_DISPLAY_SSD1306
        default 0x27
    config IRM_DISPLAY_SSD1306_HEIGHT
        int "OLED-Hoehe (32 oder 64)"
        depends on IRM_DISPLAY_SSD1306
        default 64
        range 32 64
    config IRM_DISPLAY_LCD_COLS
        int "LCD Spalten"
        depends on IRM_DISPLAY_HD44780
        default 16
        range 8 40
    config IRM_DISPLAY_LCD_ROWS
        int "LCD Zeilen"
        depends on IRM_DISPLAY_HD44780
        default 2
        range 1 4
    config IRM_SERVO_GPIO
        int "Servo-GPIO"
        depends on IRM_DISPLAY_SERVO
        default 13
    config IRM_SERVO_MIN_US
        int "Impulsbreite Anschlag links (us)"
        depends on IRM_DISPLAY_SERVO
        default 600
    config IRM_SERVO_MAX_US
        int "Impulsbreite Anschlag rechts (us)"
        depends on IRM_DISPLAY_SERVO
        default 2300

    # Versteckte Schalter fuer die Abhaengigkeitsregeln der idf_component.yml. Als int (0/1), weil abgeschaltete Bool-Optionen
    # in sdkconfig.json fehlen (das loest im Component Manager "Missing kconfig option" aus); int-Werte sind immer vorhanden.
    config IRM_DEP_U8G2
        int
        default 1 if IRM_DISPLAY_SSD1306
        default 0
    config IRM_DEP_LVGL
        int
        default 1 if IRM_DISPLAY_LVGL
        default 0
    config IRM_DEP_ILI9341
        int
        default 1 if IRM_DISPLAY_LVGL && IRM_LCD_ILI9341
        default 0
endmenu
```

## components/irm_input/Kconfig
```kconfig
menu "iRadioMini2: Eingabe"
    comment "GPIO-Nummern; -1 = Taster nicht vorhanden. Taster schalten gegen GND (active low)."
    config IRM_BTN_PLAY
        int "Taster Play/Pause (lang: Radio <-> Mediaplayer)"
        default 23
        range -1 39
    config IRM_BTN_NEXT
        int "Taster Naechster"
        default 18
        range -1 39
    config IRM_BTN_PREV
        int "Taster Vorheriger"
        default 5
        range -1 39
    config IRM_BTN_VOL_UP
        int "Taster Lauter (haltbar = Wiederholung)"
        default -1
        range -1 39
    config IRM_BTN_VOL_DOWN
        int "Taster Leiser (haltbar = Wiederholung)"
        default -1
        range -1 39
    config IRM_BTN_LONG_MS
        int "Langer Tastendruck ab (ms)"
        default 800
    config IRM_BTN_REPEAT_MS
        int "Wiederholrate Lautstaerketasten (ms)"
        default 150

    config IRM_ROTARY_A
        int "Drehgeber Pin A (-1 = kein Drehgeber)"
        default -1
        range -1 39
    config IRM_ROTARY_B
        int "Drehgeber Pin B"
        default -1
        range -1 39
    config IRM_ROTARY_COUNTS_PER_STEP
        int "PCNT-Zaehlimpulse pro Raste"
        default 4
        range 1 8
    choice IRM_ROTARY_FUNCTION
        prompt "Drehgeber-Funktion"
        default IRM_ROTARY_VOLUME
        config IRM_ROTARY_VOLUME
            bool "Lautstaerke"
        config IRM_ROTARY_STATION
            bool "Sender/Titel"
    endchoice
endmenu
```

## components/irm_kiwi/Kconfig
```kconfig
menu "iRadioMini2 KiwiSDR (irm_kiwi)"

    config IRM_KIWI_ENABLE
        bool "KiwiSDR als dritte Quelle (neben Radio und Medien)"
        default y
        help
            Hoert KiwiSDR-Empfaenger (ws://, Port meist 8073) ueber die vorhandene Ausgabesenke. Eintraege stehen in /sdcard/kiwi.m3u
            (siehe docs/KIWI.md). Kostet ca. 40 KB Flash und waehrend der Wiedergabe ca. 40 KB RAM.

    config IRM_KIWI_DEFAULT_URI
        string "Vorgabe-Eintrag, wenn keine kiwi.m3u vorhanden ist"
        depends on IRM_KIWI_ENABLE
        default ""
        help
            z. B. kiwi://kiwi.example.org:8073/?f=7055.5usb  (leer = Quelle nur mit kiwi.m3u verfuegbar).

    config IRM_KIWI_MAX_PRESETS
        int "Maximale Zahl Eintraege in kiwi.m3u"
        depends on IRM_KIWI_ENABLE
        range 1 200
        default 32

    config IRM_KIWI_USER_NAME
        string "Benutzername, der in der Nutzerliste des Kiwi erscheint"
        depends on IRM_KIWI_ENABLE
        default "iRadioMini2"

    config IRM_KIWI_ADPCM
        bool "IMA-ADPCM anfordern (ca. 1/4 Datenrate)"
        depends on IRM_KIWI_ENABLE
        default n
        help
            Rohes PCM braucht ca. 24 kByte/s, ADPCM ca. 6 kByte/s. Nur bei schwachem WLAN sinnvoll; nicht jeder Server liefert es sauber.

    config IRM_KIWI_GAIN_DB
        int "Zusaetzliche Verstaerkung der Kiwi-Audiodaten (dB)"
        depends on IRM_KIWI_ENABLE
        range 0 18
        default 6
        help
            Kiwi-Audio ist oft leiser als Musik/Radio. Wird vor der Lautstaerkeregelung angewendet und hart begrenzt.

    config IRM_KIWI_BUFFER_MS
        int "Jitterpuffer gesamt (ms)"
        depends on IRM_KIWI_ENABLE
        range 400 4000
        default 1000

    config IRM_KIWI_PREBUFFER_MS
        int "Vorpufferung vor Wiedergabebeginn und Soll-Fuellstand (ms)"
        depends on IRM_KIWI_ENABLE
        range 100 3000
        default 400

    config IRM_KIWI_CONNECT_TIMEOUT_MS
        int "Verbindungs-Timeout (ms)"
        depends on IRM_KIWI_ENABLE
        range 2000 20000
        default 8000
        help
            Waehrend eines haengenden Verbindungsaufbaus kann nicht auf einen anderen Kiwi umgeschaltet werden.

    config IRM_KIWI_MIN_RECONNECT_S
        int "Mindestabstand zwischen zwei Verbindungsversuchen (s)"
        depends on IRM_KIWI_ENABLE
        range 1 60
        default 5
        help
            Schont die oeffentlichen Server; schnelles Durchschalten der Eintraege wird entsprechend verzoegert.

    config IRM_KIWI_NET_TASK_PRIO
        int "Prioritaet des Netzwerk-Tasks"
        depends on IRM_KIWI_ENABLE
        range 1 20
        default 7

    config IRM_KIWI_OUT_TASK_PRIO
        int "Prioritaet des Ausgabe-Tasks"
        depends on IRM_KIWI_ENABLE
        range 1 24
        default 10

    config IRM_KIWI_OUT_TASK_CORE
        int "Core des Ausgabe-Tasks (-1 = beliebig)"
        depends on IRM_KIWI_ENABLE
        range -1 1
        default 1

    config IRM_KIWI_STATS_S
        int "Statistik-Logzeile alle n Sekunden (0 = aus)"
        depends on IRM_KIWI_ENABLE
        range 0 600
        default 10

    config IRM_KIWI_TUNE_STEP_HZ
        int "Schrittweite beim Abstimmen per Drehgeber (Hz)"
        depends on IRM_KIWI_ENABLE
        range 10 100000
        default 1000

    config IRM_KIWI_ROTARY_TUNES
        bool "Drehgeber stimmt im KiwiSDR-Betrieb ab (statt Eintrag wechseln)"
        depends on IRM_KIWI_ENABLE && IRM_ROTARY_STATION
        default y
        help
            Gilt nur, wenn der Drehgeber auf "Sender/Titel" konfiguriert ist (IRM_ROTARY_FUNCTION). Bei Lautstaerke aendert sich nichts.

endmenu
```

## components/irm_net/Kconfig
```kconfig
menu "iRadioMini2: Netzwerk"
    config IRM_WIFI_SSID
        string "Fallback-SSID (nur wenn weder SD-Karte noch NVS Zugangsdaten liefern)"
        default ""
    config IRM_WIFI_PASSWORD
        string "Fallback-Passwort"
        default ""
    config IRM_WIFI_HOSTNAME
        string "DHCP-Hostname"
        default "iradiomini"
    config IRM_WIFI_MAX_BACKOFF_S
        int "Maximales Reconnect-Intervall (s)"
        default 30
        range 2 300
endmenu
```

## components/irm_tx/Kconfig
```kconfig
menu "iRadioMini2: AM-Sender (RF)"
    config IRM_TX_ENABLE
        bool "AM-Kleinsender aktivieren (DDS/LEDC-Traeger)"
        default n
        help
            Erzeugt einen Traeger im Mittelwellenband, auf den das NF-Signal des Radios (Codec-Ausgang)
            ueber eine externe Modulatorstufe aufmoduliert wird. Sendeleistung und Antenne muessen den
            geltenden Vorschriften entsprechen (in Deutschland: nur extrem schwache, nicht genehmigungspflichtige
            Aussendungen; im Zweifel nur Leitungs-/Kabeleinspeisung oder abgeschirmte Aufbauten).

    choice IRM_TX_DRIVER
        prompt "Traegererzeugung"
        depends on IRM_TX_ENABLE
        default IRM_TX_AD9835
        config IRM_TX_AD9835
            bool "AD9835 (DDS, 50 MHz Takt)"
        config IRM_TX_AD9832
            bool "AD9832 (DDS, 25 MHz Takt)"
        config IRM_TX_AD9850
            bool "AD9850 (DDS, 125 MHz Takt)"
        config IRM_TX_LEDC
            bool "ESP32-intern (LEDC-Rechteck)"
    endchoice

    config IRM_TX_CARRIER_KHZ
        int "Standard-Traegerfrequenz (kHz); /sdcard/AM.txt ueberschreibt"
        depends on IRM_TX_ENABLE
        default 1000
        range 100 30000
    config IRM_TX_DDS_MCLK_HZ
        int "DDS-Referenztakt (Hz)"
        depends on IRM_TX_ENABLE && !IRM_TX_LEDC
        default 125000000 if IRM_TX_AD9850
        default 25000000 if IRM_TX_AD9832
        default 50000000

    config IRM_TX_PIN_A
        int "AD983x: FSYNC | AD9850: RESET | LEDC: Ausgang"
        depends on IRM_TX_ENABLE
        default 17
    config IRM_TX_PIN_B
        int "AD983x: SCLK | AD9850: FQ_UD"
        depends on IRM_TX_ENABLE && !IRM_TX_LEDC
        default 16
    config IRM_TX_PIN_C
        int "AD983x: SDATA | AD9850: W_CLK"
        depends on IRM_TX_ENABLE && !IRM_TX_LEDC
        default 4
    config IRM_TX_PIN_D
        int "AD9850: DATA"
        depends on IRM_TX_ENABLE && IRM_TX_AD9850
        default 12

    config IRM_INET2RF
        bool "inet2RF: Senderwahl ueber Drehkondensator/Oszillator eines Analogradios"
        depends on IRM_TX_ENABLE
        default n
        help
            Misst die Oszillatorfrequenz (PCNT) eines handelsueblichen AM-Radios, leitet daraus die
            eingestellte Skalenposition ab, waehlt den passenden Sender und setzt den Traeger auf diese Frequenz.
    config IRM_INET2RF_GPIO
        int "Frequenzeingang (Oszillatorsignal, 3,3 V!)"
        depends on IRM_INET2RF
        default 19
    config IRM_INET2RF_IF_KHZ
        int "Zwischenfrequenz (kHz); f_Oszillator = f_Empfang + ZF (z. B. 455)"
        depends on IRM_INET2RF
        default 0
    config IRM_INET2RF_MIN_KHZ
        int "Untere Bandgrenze (kHz)"
        depends on IRM_INET2RF
        default 526
    config IRM_INET2RF_MAX_KHZ
        int "Obere Bandgrenze (kHz)"
        depends on IRM_INET2RF
        default 1606
endmenu
```

## components/irm_web/Kconfig
```kconfig
menu "iRadioMini2: Web-Oberflaeche"
    config IRM_WEB_PORT
        int "HTTP-Port"
        default 80
    config IRM_WEB_USER
        string "Benutzername (HTTP Basic Auth)"
        default "radio"
    config IRM_WEB_PASSWORD
        string "Passwort (leer = keine Authentifizierung)"
        default ""
        help
            Ohne Passwort kann jeder im selben Netz das Radio steuern. HTTP Basic ist unverschluesselt;
            fuer Schutz vor Mitlesern im LAN waere HTTPS (esp_https_server) noetig.
endmenu
```
