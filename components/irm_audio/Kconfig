## components/irm_audio/Kconfig
```kconfig
menu "iRadioMini2: Audio"
    config IRM_AUDIO_TASK_STACK
        int "Pipeline-Task Stack (Byte)"
        default 8192
        help
            TLS-Handshakes (https-Streams) benoetigen >= 8 KiB.
    config IRM_AUDIO_TASK_CORE
        int "Pipeline-Task Core"
        default 1
        range 0 1
    config IRM_AUDIO_TASK_PRIO
        int "Pipeline-Task Prioritaet"
        default 10
        range 5 20
        help
            Der GMF-Standard ist 5 und damit gleich dem HTTP-Server (Web-UI): Anfragen der Web-Oberflaeche konkurrieren dann mit dem Decoder.
            10 liegt ueber HTTP-Server, Steuerung und Anzeige, aber unter WLAN- und TCP/IP-Tasks.
    config IRM_FILE_PREFETCH_KB
        int "Vorlese-Puffer fuer Dateien von der SD-Karte (KiB, 0 = aus)"
        default 32
        range 0 256
        help
            Eigene Lese-Task mit Ringpuffer. Ohne Vorlesen wirken sich Verzoegerungen der SD-Karte (FAT-Zugriffe, interne Karten-Arbeit)
            direkt als Aussetzer aus.
    config IRM_AUDIO_STATS_S
        int "Audio-Statistik im Log alle n Sekunden (0 = aus)"
        default 10
        range 0 120
        help
            Zeigt, wie viel der Echtzeit die Kette (Lesen, Decodieren, Umsetzen) belegt, und warnt sofort, wenn sie laenger ausbleibt als der Ausgabepuffer fasst.
    config IRM_PRE_GAIN_DB
        int "Pegelreserve vor Equalizer/Ausgabe (dB, 0 = aus, z. B. -3 oder -6)"
        default 0
        range -24 0
        help
            Laute Aufnahmen koennen die Ausgabe (Digital- oder Analogteil) uebersteuern, hoerbar als kurze Knackser/"Britzel". Ein Wert von -3 bis -6 dB
            schafft Reserve; die Lautstaerke wird ueber den Regler entsprechend hoeher gestellt. Dient auch als Testschalter zur Eingrenzung.
    config IRM_EQ_Q
        int "EQ-Guete Q (x100)"
        default 141
        help
            Oktavbreite Peak-Filter: Q ~ 1.41
    config IRM_HTTP_TIMEOUT_MS
        int "HTTP-Timeout beim Verbinden/Lesen (ms)"
        default 10000
        range 2000 60000
        help
            Die ESP-GMF-HTTP-Schicht verwendet fest 30 s. Ein kuerzerer Wert beschleunigt Wiederverbindung und Senderwechsel
            bei nicht erreichbaren Servern (der Senderwechsel wartet, bis die laufende Verbindungsaufnahme beendet ist).
endmenu
```

## components/irm_board/Kconfig
```kconfig
menu "iRadioMini2: Board"

    choice IRM_BOARD
        prompt "Board"
        default IRM_BOARD_AUDIOKIT
        config IRM_BOARD_AUDIOKIT
            bool "ESP32-A1S AudioKit (ES8388)"
        config IRM_BOARD_CUSTOM
            bool "Eigenes Board (Pins manuell)"
    endchoice

    choice IRM_OUTPUT
        prompt "Audio-Ausgabe"
        default IRM_OUT_CODEC
        help
            Boards ohne externen DAC koennen direkt vom ESP32 ausgeben (wie USE_INTERNAL_AUDIODAC in iRadioMini V1).
            Die Lautstaerke wird dabei in Software geregelt; PDM und DAC werden zu Mono bzw. 8 Bit reduziert
            und benoetigen extern Tiefpass/Verstaerker.
        config IRM_OUT_CODEC
            bool "I2S-Codec / externer I2S-DAC (ES8388, ES8311, PCM5102, MAX98357 ...)"
        config IRM_OUT_PDM
            bool "PDM auf einem GPIO (I2S0), Mono - RC-Tiefpass + Verstaerker extern"
            depends on SOC_I2S_SUPPORTS_PDM_TX
        config IRM_OUT_DAC
            bool "Interner 8-Bit-DAC des ESP32 (GPIO25 / GPIO26)"
            depends on SOC_DAC_SUPPORTED
    endchoice

    config IRM_PDM_DOUT
        int "PDM-Datenpin"
        depends on IRM_OUT_PDM
        default 25
    config IRM_PDM_CLK
        int "PDM-Taktpin (-1 = ungenutzt)"
        depends on IRM_OUT_PDM
        default -1
    config IRM_DAC_STEREO
        bool "DAC Stereo (GPIO25 = links, GPIO26 = rechts); aus = Mono-Signal auf beiden Pins"
        depends on IRM_OUT_DAC
        default y

    choice IRM_CODEC
        prompt "Audio-Codec / DAC"
        depends on IRM_OUT_CODEC
        default IRM_CODEC_ES8388 if IRM_BOARD_AUDIOKIT
        default IRM_CODEC_DUMMY
        config IRM_CODEC_ES8388
            bool "ES8388 (I2C-gesteuert)"
        config IRM_CODEC_ES8311
            bool "ES8311 (I2C-gesteuert)"
        config IRM_CODEC_DUMMY
            bool "Generischer I2S-DAC ohne Steuerbus (PCM5102, MAX98357, UDA1334 ...)"
    endchoice

    config IRM_ES8388_OUT_VOL
        int "ES8388: Pegel der Ausgangsstufen LOUT1/ROUT1/LOUT2/ROUT2 (0..33; 30 = 0 dB, 33 = +4,5 dB)"
        depends on IRM_CODEC_ES8388
        default 30
        range 0 33
        help
            Der esp_codec_dev-Treiber setzt LOUT1/ROUT1 auf 0 dB, LOUT2/ROUT2 aber auf -30 dB. Beim AudioKit haengen Lautsprecherverstaerker
            und Kopfhoerer an unterschiedlichen Ausgangspaaren, ein Paar ist dann praktisch stumm. Dieser Wert gilt fuer alle vier Ausgaenge
            (wie der ES8388-Patch des Altprojekts). Die eigentliche Lautstaerke regelt weiterhin die digitale DAC-Lautstaerke.

    config IRM_HP_DETECT_GPIO
        int "Kopfhoerer-Erkennung: GPIO (-1 = aus; AudioKit v2.2: 39, Eingang ohne internen Pull-up)"
        depends on IRM_OUT_CODEC
        default 39 if IRM_BOARD_AUDIOKIT
        default -1
        help
            Bei jedem Wechsel wird der Pegel protokolliert ("Kopfhoerer-Erkennung: GPIO39=..."), so laesst sich die Polaritaet pruefen.
    config IRM_HP_ACTIVE_LEVEL
        int "Pegel bei eingestecktem Kopfhoerer (0 oder 1)"
        depends on IRM_OUT_CODEC && IRM_HP_DETECT_GPIO >= 0
        default 0
        range 0 1
    config IRM_HP_MUTE_SPEAKER
        bool "Lautsprecher-Endstufe (PA-GPIO) bei erkanntem Kopfhoerer abschalten"
        depends on IRM_OUT_CODEC && IRM_HP_DETECT_GPIO >= 0 && IRM_PA_GPIO >= 0
        default n
        help
            Erst aktivieren, nachdem die Protokollzeile die richtige Polaritaet gezeigt hat; bei falschem Pegel bleibt sonst der Lautsprecher stumm.

    config IRM_AUDIO_DMA_MS
        int "Tiefe des Ausgabepuffers (I2S-/DAC-DMA) in ms"
        default 100
        range 30 400
        help
            Der Standardpuffer des I2S-Treibers (6 x 240 Frames) fasst nur 30 ms. Jede Verzoegerung der Pipeline darueber (SD-Karte, WLAN, HTTP-Server)
            fuehrt zu hoerbaren Aussetzern. Der Puffer liegt im internen DMA-RAM: ca. 0,2 KiB je ms bei 48 kHz Stereo (100 ms = 19 KiB).

    config IRM_AUDIO_OUT_RATE
        int "Ausgabe-Samplerate (Hz); alle Streams werden darauf resampled"
        default 48000
        range 8000 96000

    config IRM_I2C_SDA
        int "Codec-I2C SDA"
        depends on IRM_CODEC_ES8388 || IRM_CODEC_ES8311
        default 33 if IRM_BOARD_AUDIOKIT
        default 21
    config IRM_I2C_SCL
        int "Codec-I2C SCL"
        depends on IRM_CODEC_ES8388 || IRM_CODEC_ES8311
        default 32 if IRM_BOARD_AUDIOKIT
        default 22
    comment "I2C fuer I2C-Displays (SSD1306 / HD44780): eigener Bus wie im Altprojekt (dort I2C_NUM_1, GPIO21/22), unabhaengig vom Codec-Bus"
    config IRM_DISP_I2C_SHARED
        bool "Display am Codec-I2C-Bus betreiben (statt eigenem Bus)"
        depends on IRM_OUT_CODEC && (IRM_CODEC_ES8388 || IRM_CODEC_ES8311)
        default n
        help
            Nur sinnvoll, wenn die Codec-Busleitungen (IRM_I2C_SDA/SCL) herausgefuehrt sind. Beim AudioKit sind sie es nicht.
    config IRM_DISP_I2C_PORT
        int "Display-I2C Controller (0 oder 1)"
        depends on !IRM_DISP_I2C_SHARED
        default 1
        range 0 1
        help
            Der ESP32 hat zwei I2C-Controller. Wie im Altprojekt (Codec: Controller 0, uebrige I2C-Geraete: Controller 1) bleibt der Codec
            raeumlich getrennt auf Controller 0. Nur aendern, wenn kein I2C-Codec verwendet wird.
    config IRM_DISP_I2C_SDA
        int "Display-I2C SDA (eigener Bus)"
        depends on !IRM_DISP_I2C_SHARED
        default 21
        help
            Frei waehlbar; Kollisionen mit Onboard-Funktionen liegen in der Verantwortung des Nutzers. Hinweis AudioKit: GPIO21 ist dort auch der
            Enable-Pin der Lautsprecher-Endstufe (IRM_PA_GPIO). Wird er als SDA verwendet, haelt der I2C-Pull-up die Endstufe aktiviert
            (wie im Altprojekt); die Kopfhoerer-Abschaltung der Endstufe ist dann nicht nutzbar (wird automatisch uebersprungen).
    config IRM_DISP_I2C_SCL
        int "Display-I2C SCL (eigener Bus)"
        depends on !IRM_DISP_I2C_SHARED
        default 22

    config IRM_I2S_MCLK
        depends on IRM_OUT_CODEC
        int "I2S MCLK (-1 = nicht genutzt)"
        default 0 if IRM_BOARD_AUDIOKIT
        default -1
    config IRM_I2S_BCLK
        depends on IRM_OUT_CODEC
        int "I2S BCLK"
        default 27 if IRM_BOARD_AUDIOKIT
        default 26
    config IRM_I2S_WS
        depends on IRM_OUT_CODEC
        int "I2S WS/LRCK"
        default 25
    config IRM_I2S_DOUT
        depends on IRM_OUT_CODEC
        int "I2S DOUT"
        default 26 if IRM_BOARD_AUDIOKIT
        default 22
    config IRM_PA_GPIO
        depends on IRM_OUT_CODEC
        int "Endstufen-Enable-GPIO (-1 = keiner)"
        default 21 if IRM_BOARD_AUDIOKIT
        default -1

    config IRM_SD_ENABLE
        bool "SD-Karte einbinden (/sdcard)"
        default y
    choice IRM_SD_MODE
        prompt "SD-Anbindung"
        depends on IRM_SD_ENABLE
        default IRM_SD_SDMMC_1BIT if IRM_BOARD_AUDIOKIT
        default IRM_SD_SPI
        config IRM_SD_SDMMC_1BIT
            bool "SDMMC 1-Bit (CLK14 CMD15 D0=2)"
        config IRM_SD_SPI
            bool "SPI"
    endchoice
    config IRM_SD_SPI_MOSI
        int "SD-SPI MOSI"
        depends on IRM_SD_SPI
        default 23
    config IRM_SD_SPI_MISO
        int "SD-SPI MISO"
        depends on IRM_SD_SPI
        default 19
    config IRM_SD_SPI_SCLK
        int "SD-SPI SCLK"
        depends on IRM_SD_SPI
        default 18
    config IRM_SD_SPI_CS
        int "SD-SPI CS"
        depends on IRM_SD_SPI
        default 5
endmenu
```

## components/irm_control/Kconfig
```kconfig
menu "iRadioMini2: Steuerung"
    config IRM_MAX_STATIONS
        int "Maximale Anzahl Sender in playlist.m3u"
        default 100
        range 1 500
    config IRM_MAX_MEDIA_FILES
        int "Maximale Anzahl Mediendateien beim SD-Scan"
        default 300
        range 1 2000
    config IRM_VOLUME_STEP
        int "Lautstaerke-Schritt (%)"
        default 3
        range 1 20
    config IRM_MEDIA_EXTENSIONS
        string "Dateiendungen fuer den Mediaplayer"
        default "mp3,aac,m4a,wav,flac"
    config IRM_PERSIST_DELAY_MS
        int "Verzoegerung bis Lautstaerke/Sender in NVS geschrieben werden (ms)"
        default 3000
    config IRM_RETRY_MAX_S
        int "Maximales Wiederverbindungsintervall bei Streamfehlern (s)"
        default 30
endmenu
```

## components/irm_dir/Kconfig
```kconfig
menu "iRadioMini2 Serververzeichnis (irm_dir)"

    config IRM_DIR_ENABLE
        bool "KiwiSDR-Serververzeichnis (Suchen/Waehlen im Web-UI)"
        depends on IRM_KIWI_ENABLE
        default y
        help
            Haelt eine kompakte Liste der oeffentlichen KiwiSDR-Server in der Flash-Partition "kiwidb" (siehe partitions.csv, 2 x 192 KB).
            Die Liste wird im Web-UI ueber "Liste aktualisieren" geladen (ca. 0,9 MB per HTTP). Ohne die Partition bleibt die Funktion aus.

    config IRM_DIR_URL
        string "URL der Serverliste (nur http://)"
        depends on IRM_DIR_ENABLE
        default "http://rx.linkfanel.net/kiwisdr_com.js"
        help
            Maschinenlesbare Liste der oeffentlichen KiwiSDR-Server. Das Update zerlegt sie waehrend des Empfangs und legt die Datenbank im Flash ab.

    config IRM_DIR_MIN_INTERVAL_S
        int "Mindestabstand zwischen zwei Updates (s)"
        depends on IRM_DIR_ENABLE
        range 0 86400
        default 60
        help
            Schont den Verzeichnisdienst und die Flash-Schreibzyklen; im Web-UI laesst sich der Abstand mit "erzwingen" umgehen.

    config IRM_DIR_DEFAULT_FREQ_KHZ
        int "Startfrequenz, wenn ein Server gewaehlt wird, ohne dass zuvor KiwiSDR lief (kHz)"
        depends on IRM_DIR_ENABLE
        range 10 32000
        default 6070
        help
            Lief KiwiSDR bereits, wird beim Serverwechsel die aktuelle Frequenz/der Modus uebernommen.

    config IRM_DIR_DEFAULT_MODE
        string "Startmodus (am, amn, amw, sam, lsb, usb, cw, nbfm, ...)"
        depends on IRM_DIR_ENABLE
        default "am"

endmenu
```

## components/irm_disp_lvgl/Kconfig
```kconfig
menu "iRadioMini2: LVGL-Display"
    depends on IRM_DISPLAY_LVGL

    choice IRM_LCD_PANEL
        prompt "Display-Controller (SPI)"
        default IRM_LCD_ILI9341
        config IRM_LCD_ILI9341
            bool "ILI9341 (240x320)"
        config IRM_LCD_ST7789
            bool "ST7789"
    endchoice

    choice IRM_LVGL_SKIN
        prompt "Skin"
        default IRM_LVGL_SKIN_LINEAR
        config IRM_LVGL_SKIN_BASIC
            bool "Basis: Programmnummer, Name, Vor/Zurueck-Tasten (Touch)"
        config IRM_LVGL_SKIN_LINEAR
            bool "Skalensimulation: Zeiger auf linearer Senderskala"
        config IRM_LVGL_SKIN_ROUND
            bool "Rundskala (Mende 148): Zeiger dreht ueber Halbkreisskala"
        config IRM_LVGL_SKIN_CASSETTE
            bool "Kassettenspieler: drehende Spulen"
    endchoice

    config IRM_LCD_H_RES
        int "Horizontale Aufloesung (nach Rotation)"
        default 320
    config IRM_LCD_V_RES
        int "Vertikale Aufloesung (nach Rotation)"
        default 240
    config IRM_LCD_SWAP_XY
        bool "X/Y tauschen (Querformat bei 240x320-Panels)"
        default y
    config IRM_LCD_MIRROR_X
        bool "X spiegeln"
        default y
    config IRM_LCD_MIRROR_Y
        bool "Y spiegeln"
        default n
    config IRM_LCD_BGR
        bool "Farbreihenfolge BGR"
        default y
    config IRM_LCD_INVERT
        bool "Farben invertieren (ST7789 oft noetig)"
        default n

    config IRM_LCD_SPI_HOST
        int "SPI-Host (1 = SPI2/HSPI, 2 = SPI3/VSPI)"
        default 1
        range 1 2
    config IRM_LCD_SPI_MHZ
        int "SPI-Takt (MHz); ueber GPIO-Matrix <= 26 sinnvoll"
        default 20
    config IRM_LCD_SCLK
        int "SCLK-GPIO"
        default 19
    config IRM_LCD_MOSI
        int "MOSI-GPIO"
        default 13
    config IRM_LCD_CS
        int "CS-GPIO"
        default 22
    config IRM_LCD_DC
        int "DC-GPIO"
        default 4
    config IRM_LCD_RST
        int "RESET-GPIO (-1 = keiner)"
        default 16
    config IRM_LCD_BL
        int "Hintergrundbeleuchtung-GPIO, high-aktiv (-1 = keiner)"
        default 17
    config IRM_LCD_BUF_LINES
        int "Zeilen je LVGL-Teilpuffer (zwei Puffer im DMA-RAM)"
        default 20
        range 5 60
endmenu
```
